## app/hello_app/fitness/Kconfig
```kconfig
#
# For a description of the syntax of this configuration file,
# see the file kconfig-language.txt in the NuttX tools repository.
#
menuconfig EXAMPLES_FITNESS
	tristate "Middle School Fitness Test App"
	default n
	depends on GRAPHICS_LVGL
	---help---\
		LVGL-based middle school student physical fitness test\
		application for OpenVela/SF32LB52 wearable platform.

if EXAMPLES_FITNESS

config EXAMPLES_FITNESS_PRIORITY
	int "Fitness app task priority"
	default 100

config EXAMPLES_FITNESS_STACKSIZE
	int "Fitness app stack size"
	default 65536

config EXAMPLES_FITNESS_INPUT_DEVPATH
	string "Touchscreen device path"
	default "/dev/input0"
	depends on INPUT_TOUCHSCREEN
	---help---\
		The path to the touchscreen device.

config EXAMPLES_FITNESS_SCREEN_WIDTH
	int "Screen width in pixels"
	default 390
	---help---\
		Width of the display in pixels.

config EXAMPLES_FITNESS_SCREEN_HEIGHT
	int "Screen height in pixels"
	default 450
	---help---\
		Height of the display in pixels.

config EXAMPLES_FITNESS_SERVER_URL
	string "Backend server URL"
	default "http://101.35.231.154:9000"
	---help---\
		Base URL of the fitness test backend API.

config EXAMPLES_FITNESS_DEVICE_SN
	string "Device serial number"
	default "FS-2026-0001"
	---help---\
		Unique device serial number.

config EXAMPLES_FITNESS_STUDENT_ID
	string "Student ID"
	default "STU20260001"
	---help---\
		Default student ID.

config EXAMPLES_FITNESS_STUDENT_NAME
	string "Student name"
	default "Zhang Xiaoming"
	---help---\
		Default student name.

endif # EXAMPLES_FITNESS
```
